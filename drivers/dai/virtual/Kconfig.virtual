## drivers/dai/virtual/Kconfig.virtual
```kconfig
# SOF Virtual DAI configuration options

# Copyright (c) 2022 Intel Corporation
# SPDX-License-Identifier: Apache-2.0

config DAI_VIRTUAL
	bool "Virtual DAI driver support for SOF"
	default y
	help
	  Enable support for a Virtual DAI (Digital Audio Interface) in SOF.
	  This driver is useful for debugging and rapid prototyping without
	  real hardware. It simulates audio input/output behavior in software
	  and is useful in memory-to-memory pipelines.
```

## dts/bindings/dai/sof,virtual-dai.yaml
```yaml
# Copyright (c) 2025, Suraj Sonawane <surajsonawane0215@gmail.com@gmail.com>
# SPDX-License-Identifier: Apache-2.0

description: |
  Zephyr binding for a Virtual DAI (Digital Audio Interface).

  This DAI is not connected to real hardware and is used for software-only
  audio routing or testing within SOF + Zephyr systems.

compatible: "sof,virtual-dai"

include: base.yaml

properties:
  dai-index:
    type: int
    description: |
      DAI index used to identify this virtual DAI in IPC and topology.
```
